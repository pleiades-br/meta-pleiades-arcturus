## conf/layer.conf
```bitbake
# We have a conf and classes directory, add to BBPATH
BBPATH .= ":${LAYERDIR}"

# We have recipes-* directories, add to BBFILES
BBFILES += "${LAYERDIR}/recipes-*/*/*.bb \
            ${LAYERDIR}/recipes-*/*/*.bbappend"

BBFILE_COLLECTIONS += "meta-pleiades-arcturus"
BBFILE_PATTERN_meta-pleiades-arcturus = "^${LAYERDIR}/"
BBFILE_PRIORITY_meta-pleiades-arcturus = "98"

LAYERSERIES_COMPAT_meta-pleiades-arcturus = "kirkstone"
```

## conf/machine/plds-myd-y6ull.conf
```bitbake
#@TYPE: Machine
#@NAME: Pleaides board with MYiR MYS-6ULL 14X14
#@SOC: i.MX6ULL
#@DESCRIPTION: Machine configuration for NXP i.MX6ULL 14x14 EVK
#@MAINTAINER: Aluisio L Victal <alvictal@gmail.com>

MACHINEOVERRIDES =. "mx6:mx6ul:mx6ull:"

MACHINENAME= "plds-myd-y6ull-arcturus"
include conf/machine/include/imx-base.inc
include conf/machine/include/arm/armv7a/tune-cortexa7.inc

MACHINE_FIRMWARE:append:mx6 = " linux-firmware-imx-sdma-imx6q"

KERNEL_DEVICETREE = "myd-y6ull-emmc-arcturus.dtb \
                     myd-y6ull-gpmi-weim-arcturus.dtb \
                     myb-imx6ull-14x14-base-arcturus.dtb \
"
SPL_BINARY:pn-u-boot-imx = ""
UBOOT_MAKE_TARGET = "u-boot.imx"
UBOOT_SUFFIX = "imx"
#UBOOT_MAKE_TARGET:pn-u-boot-imx = "u-boot.imx"
#UBOOT_MAKE_TARGET:pn-u-boot-imx-mfgtool = "u-boot.imx"
#UBOOT_SUFFIX:pn-u-boot-imx = "imx"
#UBOOT_SUFFIX:pn-u-boot-imx-mfgtool = "imx"

UBOOT_CONFIG ??= "${@bb.utils.contains('MACHINE_FEATURES', 'optee', 'sd-optee', 'sd', d)}"
UBOOT_CONFIG ??= "nand emmc sd"
UBOOT_CONFIG[sd] = "mx6ull_14x14_evk_emmc_defconfig,sdcard"
UBOOT_CONFIG[emmc] = "mx6ull_14x14_evk_emmc_defconfig,sdcard"
UBOOT_CONFIG[nand] = "mx6ull_14x14_evk_nand_defconfig,ubifs"
UBOOT_CONFIG[mfgtool] = "mx6ull_14x14_evk_config"
UBOOT_CONFIG[sd-optee] = "mx6ull_14x14_evk_emmc_defconfig,sdcard"

OPTEE_BIN_EXT = "6ullevk"

MACHINE_FEATURES += "wifi optee"
```
